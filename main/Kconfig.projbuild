## main/Kconfig.projbuild
```kconfig
menu "ESP32 MQTT connectivity demo"

config CONNECTIVITY_WIFI_SSID
    string "Wi-Fi SSID"
    default ""
    help
        Station network used by the firmware. This value is compiled into the
        firmware image; use a local, ignored sdkconfig and do not commit it.

config CONNECTIVITY_WIFI_PASSWORD
    string "Wi-Fi password"
    default ""
    help
        Station network password. Leave empty only for an open Wi-Fi network.
        This value is compiled into the firmware image.

config CONNECTIVITY_MQTT_BROKER_URI
    string "MQTT broker URI"
    default ""
    help
        Use mqtt://host:1883 for plaintext or mqtts://host:8883 for TLS.
        Do not put credentials in the URI. The URI is compiled into firmware.

config CONNECTIVITY_MQTT_USERNAME
    string "MQTT username"
    default ""
    help
        Optional MQTT username. Use TLS if the broker requires credentials.

config CONNECTIVITY_MQTT_PASSWORD
    string "MQTT password"
    default ""
    help
        Optional MQTT password. This value is compiled into firmware.

config CONNECTIVITY_MQTT_USE_CUSTOM_CA
    bool "Trust a local MQTT broker CA certificate"
    default n
    help
        Enable this only when mqtt_connectivity/broker_ca.pem contains the
        CA certificate for a development broker. The PEM is embedded in the
        firmware image; never put the CA private key in the project.

config CONNECTIVITY_FALLBACK_AP_SSID
    string "Fallback access point SSID"
    default "ESP32_Fault_Tolerant_IoT_LAN"
    help
        SSID advertised when station Wi-Fi cannot be reached.

config CONNECTIVITY_FALLBACK_AP_PASSWORD
    string "Fallback access point password"
    default ""
    help
        Required to start the fallback access point; use 8-63 characters.
        This value is compiled into firmware.

endmenu
```
