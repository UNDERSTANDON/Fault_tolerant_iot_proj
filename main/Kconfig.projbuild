## main/Kconfig.projbuild
```kconfig
menu "ESP32 MQTT connectivity demo"

config CONNECTIVITY_WIFI_SSID
    string "Wi-Fi SSID"
    default ""
    help
        Station network used by the firmware. This value is compiled into the
        firmware image; use a local, ignored sdkconfig and do not commit it.

config CONNECTIVITY_WIFI_PASSWORD
    string "Wi-Fi password"
    default ""
    help
        Station network password. Leave empty only for an open Wi-Fi network.
        This value is compiled into the firmware image.

config CONNECTIVITY_MQTT_BROKER_URI
    string "MQTT broker URI"
    default ""
    help
        Use mqtt://host:1883 for plaintext or mqtts://host:8883 for TLS.
        Do not put credentials in the URI. The URI is compiled into firmware.

config CONNECTIVITY_MQTT_USERNAME
    string "MQTT username"
    default ""
    help
        Optional MQTT username. Use TLS if the broker requires credentials.

config CONNECTIVITY_MQTT_PASSWORD
    string "MQTT password"
    default ""
    help
        Optional MQTT password. This value is compiled into firmware.

config CONNECTIVITY_MQTT_USE_CUSTOM_CA
    bool "Trust a local MQTT broker CA certificate"
    default n
    help
        Enable this only when mqtt_connectivity/broker_ca.pem contains the
        CA certificate for a development broker. The PEM is embedded in the
        firmware image; never put the CA private key in the project.

config CONNECTIVITY_ENABLE_MOCK_EVENT_NOTIFICATIONS
    bool "Publish synthetic warning/critical notifications for testing"
    default n
    help
        Test only. Publishes four synthetic warning/critical notification
        events to the isolated test topic after MQTT connects. Keep disabled
        in production firmware.

config CONNECTIVITY_FALLBACK_AP_SSID
    string "Fallback access point SSID"
    default "ESP32_Fault_Tolerant_IoT_LAN"
    help
        SSID advertised when station Wi-Fi cannot be reached.

config CONNECTIVITY_FALLBACK_AP_PASSWORD
    string "Fallback access point password"
    default ""
    help
        Required to start the fallback access point; use 8-63 characters.
        This value is compiled into firmware.

endmenu

menu "Local controller GPIO mapping"

config LOCAL_HARDWARE_ENABLE
    bool "Enable real DHT11, MQ-2, 4 LEDs, Door Servo and Fan GPIO drivers"
    default y
    help
        Enables real sensor polling and GPIO/LEDC actuator output on the
        mapped ESP32-S3 pins. Disable only for dry-run firmware without IO.

config LOCAL_GPIO_SENSOR_INPUT_1
    int "Legacy sensor input 1 GPIO"
    range -1 48
    default -1
    help
        Optional legacy role. Keep at -1 unless explicitly needed.

config LOCAL_GPIO_LIGHT_RELAY_1
    int "Legacy light relay 1 GPIO"
    range -1 48
    default -1
    help
        Optional legacy role. Keep at -1 unless explicitly needed.

config LOCAL_GPIO_MQ2_ADC
    int "MQ-2 smoke analog AO GPIO (ADC1: 1..10)"
    range -1 48
    default 1
    help
        ESP32-S3 ADC1 channel pin connected to MQ-2 AO (use voltage divider
        if powered from 5V). Default GPIO1.

config LOCAL_GPIO_DHT11
    int "DHT11 data GPIO"
    range -1 48
    default 4
    help
        ESP32-S3 1-Wire pin connected to DHT11 DATA (VCC 3V3). Default GPIO4.

config LOCAL_GPIO_LED_LIVING
    int "LED 1 (Living Room) GPIO"
    range -1 48
    default 5
    help
        GPIO -> 330 Ohm -> LED(+) -> GND. Default GPIO5.

config LOCAL_GPIO_LED_BEDROOM
    int "LED 2 (Bedroom) GPIO"
    range -1 48
    default 6
    help
        GPIO -> 330 Ohm -> LED(+) -> GND. Default GPIO6.

config LOCAL_GPIO_LED_KITCHEN
    int "LED 3 (Kitchen) GPIO"
    range -1 48
    default 7
    help
        GPIO -> 330 Ohm -> LED(+) -> GND. Default GPIO7.

config LOCAL_GPIO_LED_HALLWAY
    int "LED 4 (Hallway) GPIO"
    range -1 48
    default 21
    help
        GPIO -> 330 Ohm -> LED(+) -> GND. Default GPIO21.

config LOCAL_GPIO_DOOR_SERVO
    int "Door Servo (SG90/MG90S) PWM GPIO"
    range -1 48
    default 8
    help
        50Hz LEDC PWM signal pin for door lock/unlock servo. Default GPIO8.

config LOCAL_GPIO_FAN_OUTPUT
    int "Ventilation Fan actuator GPIO (standby/relay)"
    range -1 48
    default 9
    help
        Standby digital output pin for ventilation fan relay/MOSFET. Default GPIO9.

config LOCAL_FAN_ACTIVE_LOW
    bool "Fan output is active-low (optocoupler relay module)"
    default n

config LOCAL_MQ2_ALERT_MV
    int "MQ-2 smoke alert threshold at GPIO pin (mV)"
    range 100 3300
    default 1600
    help
        ADC pin voltage threshold in millivolts above which MQ-2 triggers
        CRITICAL smoke hazard alert (with 15% hysteresis).

config LOCAL_MQ2_PREHEAT_SECONDS
    int "MQ-2 warm-up guard duration after boot (seconds)"
    range 0 180
    default 30

config LOCAL_MQ2_DIVIDER_X100
    int "MQ-2 voltage divider scale x100 (100=direct, 150=10k+20k, 200=10k+10k)"
    range 100 300
    default 100

endmenu
```
